/*******************************************************************************
* Filename : event.c
* Version  : V1.0
********************************************************************************
* Note(s)  : 
*******************************************************************************/


/*******************************************************************************
*                                 INCLUDE FILES
*******************************************************************************/
#include "stdint.h"
#include "event.h"
#include "stm32l0xx_hal.h"

/*******************************************************************************
*                                 LOCAL DEFINES
*******************************************************************************/

/*******************************************************************************
*                             LOCAL GLOBAL VARIABLES
*******************************************************************************/

/*******************************************************************************
*                            LOCAL FUNCTION PROTOTYPES
*******************************************************************************/
static uint32_t event_tick_get(void);

/*******************************************************************************
*函数名: event_create
*说明: 创建事件
*参数: evt - 事件ID
       p_q - 事件队列ID
       p_e - 事件队列元素地址
       e_num - 事件队列元素数目
*返回: 无
*其他: 无
*******************************************************************************/
void event_create(event_t *evt,
                  queue_t *p_q,
                  event_element_t *p_e,
                  uint32_t e_num)
{
    if(evt == (event_t *)0)
      return;
    
    if(p_q == (queue_t *)0)
      return;
    
    if(p_e == (event_element_t *)0)
      return;
  
    evt->elements = p_e;
    evt->queue = p_q;
  
    queue_init(evt->queue, 
               evt->elements, 
               e_num, 
               sizeof(event_element_t));
}

/*******************************************************************************
*函数名: event_send
*说明: 发送事件
*参数: evt - 事件ID
       p_e - 发送的事件信息
*返回: 0 - OK
       -1 - ERROR
*其他: 无
*******************************************************************************/
int32_t event_send(event_t *evt, event_element_t *p_e)
{
    int32_t ret;
    
    if(evt == (event_t *)0)
      return -1;
    
    if(p_e == (event_element_t *)0)
      return -1;
    
    ret = queue_push(evt->queue, p_e);
  
    return ret;
}

/*******************************************************************************
*函数名: event_wait
*说明: 等待事件
*参数: evt - 事件ID
       p_e - 等到的事件信息
       timeout - 等待超时时间
*返回: 0 - OK
       -1 - ERROR
*其他: 无
*******************************************************************************/
int32_t event_wait(event_t *evt, event_element_t *p_e, uint32_t timeout)
{
    int32_t ret;
    uint32_t tick;
    
    if(evt == (event_t *)0)
      return -1;
    
    if(p_e == (event_element_t *)0)
      return -1;
    
    tick = event_tick_get();
    
    do{
        ret = queue_pop(evt->queue, p_e);
    }while((ret != 0) && (event_tick_get() - tick < timeout));
  
    return ret;
}

/*******************************************************************************
*函数名: event_tick_get
*说明: 事件超时tick获取
*参数: 无
*返回: 当前tick
*其他: 无
*******************************************************************************/
static uint32_t event_tick_get(void)
{
    uint32_t tick;
  
    //extern uint32_t bsp_sys_tick_get(void);
    
    tick = HAL_GetTick();
    
    return tick;
}